## firmware/components/board/Kconfig
```kconfig
menu "OpenRV board"

    config OPENRV_BUTTON_GPIO
        int "Button GPIO (-1 for none)"
        range -1 48
        default 0
        help
            The button people press on the gateway, active low. Most ESP32-S3 boards have a BOOT
            button on GPIO 0. Hold it 3 seconds to let a phone pair, 10 seconds to factory reset.

    config OPENRV_LED_GPIO
        int "Status RGB LED (WS2812) GPIO (-1 for none)"
        range -1 48
        default 48
        help
            The board's addressable RGB LED, which shows what the gateway is doing. ESP32-S3
            DevKitC-1 style boards have it on GPIO 48 (some on 38).

endmenu
```
